
qcom,ATL_2454091_lenovo_bl271scud_3100mah_averaged_masterslave_jun27th2016 {
	/* #2454091_Lenovo_BL271scud_3100mAh_averaged_MasterSlave_Jun27th2016*/
	qcom,max-voltage-uv = <4400000>;
	qcom,nom-batt-capacity-mah = <3100>;
	qcom,batt-id-kohm = <50>;
	qcom,battery-beta = <3380>;
	qcom,thermal-coefficients = [da 86 f0 50 08 3c]; /* 3380 */
	qcom,battery-type = "ATL_2454091_lenovo_bl271scud_3100mah_averaged_masterslave_jun27th2016";
	qcom,chg-rslow-comp-c1 = <2528376>;
	qcom,chg-rslow-comp-c2 = <2579416>;
	qcom,chg-rs-to-rslow = <862260>;
	qcom,chg-rslow-comp-thr = <0x99>;
	qcom,checksum = <0x5250>;
	qcom,gui-version = "PMI8996GUI - 1.1.0.0";
	qcom,fg-profile-data = [
		 E1 83 D7 7C 
		 27 81 6A 77 
		 65 83 7D 74 
		 77 89 7A 94 
		 36 82 6C 99 
		 47 BC 92 C8 
		 56 11 0C 88 
		 73 7E 44 82 
		 B7 7C 4B 83 
		 7D 71 1B 6E 
		 E4 74 55 82 
		 63 99 96 BC 
		 4C C9 5E 0D 
		 04 0C 12 5B 
		 14 70 9F FD 
		 37 3C 8E 3D 
		 FD 16 00 00 
		 C7 45 B0 31 
		 6D 37 00 00 
		 00 00 00 00 
		 00 00 00 00 
		 7F 6B E0 69 
		 A6 73 1A 89 
		 59 74 0A 62 
		 54 3B 9B 7B 
		 C8 6F 2E 61 
		 EF 6F 08 A0 
		 1A BB 61 87 
		 5F A0 71 0C 
		 28 00 FF 36 
		 F0 11 30 03 
		 00 00 00 0C 
	];
};
