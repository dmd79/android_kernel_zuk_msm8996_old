
qcom,Coslight_32k_2454140_lenovo_bl271drn_3000mah_averaged_masterslave_jul5th2016 {
	/* #2454140_Lenovo_BL271DRN_3000mAh_averaged_MasterSlave_Jul5th2016*/
	qcom,max-voltage-uv = <4400000>;
	qcom,nom-batt-capacity-mah = <3000>;
	qcom,batt-id-kohm = <32>;
	qcom,battery-beta = <3435>;
	qcom,thermal-coefficients = [c8 86 c1 50 d3 37]; /* 3430 */
	qcom,battery-type = "Coslight_32k_2454140_lenovo_bl271drn_3000mah_averaged_masterslave_jul5th2016";
	qcom,chg-rslow-comp-c1 = <3780373>;
	qcom,chg-rslow-comp-c2 = <6026461>;
	qcom,chg-rs-to-rslow = <771059>;
	qcom,chg-rslow-comp-thr = <0xAF>;
	qcom,checksum = <0xD846>;
	qcom,gui-version = "PMI8996GUI - 1.1.0.0";
	qcom,fg-profile-data = [
		 E0 83 C1 7C 
		 EC 80 C9 76 
		 65 83 6F 74 
		 9F 89 CA 94 
		 33 82 D0 99 
		 DA BC 75 C9 
		 55 10 EF 83 
		 C7 7C C8 80 
		 41 76 5D 83 
		 E5 42 CC 82 
		 03 8F 55 82 
		 B1 99 0D BD 
		 0C CA 52 0D 
		 1D 0C C3 5B 
		 14 70 B2 FD 
		 0B 3D F5 3F 
		 6E 3B 00 00 
		 3C 45 1C 31 
		 FD 26 00 00 
		 00 00 00 00 
		 00 00 00 00 
		 9D 6A D8 68 
		 A9 75 34 89 
		 05 7C CB 70 
		 63 6F B4 7A 
		 E4 75 50 6A 
		 3D 63 7A AA 
		 20 22 60 81 
		 5D A0 71 0C 
		 28 00 FF 36 
		 F0 11 30 03 
		 00 00 00 0C 
	];
};
